## Kconfig
```kconfig
choice
    prompt "platform"
    default PLATFORM_NUTTX
    config PLATFORM_NUTTX
        bool "nuttx"
endchoice

config BOARD_PLATFORM
    string
    default "nuttx" if PLATFORM_NUTTX

config BOARD_TOOLCHAIN
    string "Toolchain"
    default ""

config BOARD_ARCHITECTURE
    string "Architecture"
    default ""

config NUTTX_CONFIG
    string "nuttx defconfig"
    default "nsh" if PLATFORM_NUTTX

menu "Tarox modules"

config MODULES_BLDC
    bool "bldc built-in app"
    default n
    help
      Builds src/modules/bldc when enabled in this board .taroxconfig.
      Requires NuttX CONFIG_PWM_MULTICHAN, TIM1 PWM, and board BLDC setup.

endmenu

menu "Tarox drivers"

config DRIVERS_AS5600
    bool "as5600 encoder driver"
    default n
    help
      Builds src/drivers/as5600 as a uORB publisher for encoder_angle.

config DRIVERS_PWM_OUT
    bool "pwm_out actuator output driver"
    default n
    help
      Builds src/drivers/pwm_out as a uORB actuator_phase_duty consumer.

endmenu
```

## boards/demo/nuttx-config/nsh/defconfig
```kconfig
CONFIG_ARCH="arm"
CONFIG_ARCH_BOARD_CUSTOM=y
CONFIG_ARCH_BOARD_CUSTOM_DIR="../../../../boards/demo/nuttx-config"
CONFIG_ARCH_BOARD_CUSTOM_DIR_RELPATH=y
CONFIG_ARCH_BOARD_CUSTOM_NAME="demo"
CONFIG_ARCH_CHIP="stm32"
CONFIG_ARCH_CHIP_STM32=y
CONFIG_ARCH_CHIP_STM32F407ZG=y
CONFIG_BUILTIN=y
CONFIG_NSH_BUILTIN_APPS=y
CONFIG_DEV_CONSOLE=y
CONFIG_CONSOLE_SERIAL=y
CONFIG_STM32_USART3=y
CONFIG_USART3_SERIAL_CONSOLE=y
CONFIG_USART3_BAUD=115200
CONFIG_USART3_BITS=8
CONFIG_USART3_PARITY=0
CONFIG_USART3_2STOP=0
CONFIG_INIT_ENTRYPOINT="nsh_main"
CONFIG_SYSTEM_NSH=y
CONFIG_BOARDCTL_APP_INIT=y
CONFIG_NSH_ARCHINIT=y
CONFIG_SYSLOG=y
CONFIG_SYSLOG_CONSOLE=y
CONFIG_PWM=y
CONFIG_STM32_PWR=y
CONFIG_STM32_TIM4=y
CONFIG_STM32_TIM4_CH2OUT=y
CONFIG_STM32_TIM4_CHMODE=6
CONFIG_STM32_TIM4_CHANNEL=2
CONFIG_STM32_TIM4_PWM=y
```

## boards/flysq/v1/nuttx-config/nsh/defconfig
```kconfig
CONFIG_ARCH="arm"
CONFIG_ARCH_BOARD_CUSTOM=y
CONFIG_ARCH_BOARD_CUSTOM_DIR="../../../../boards/flysq/v1/nuttx-config"
CONFIG_ARCH_BOARD_CUSTOM_DIR_RELPATH=y
CONFIG_ARCH_BOARD_CUSTOM_NAME="flysq"
CONFIG_ARCH_CHIP="stm32"
CONFIG_ARCH_CHIP_STM32=y
CONFIG_ARCH_CHIP_STM32F407ZG=y
CONFIG_DEV_CONSOLE=y
CONFIG_CONSOLE_SERIAL=y
CONFIG_STM32_USART3=y
CONFIG_USART3_SERIAL_CONSOLE=y
CONFIG_USART3_BAUD=115200
CONFIG_USART3_BITS=8
CONFIG_USART3_PARITY=0
CONFIG_USART3_2STOP=0
CONFIG_INIT_ENTRYPOINT="nsh_main"
CONFIG_SYSTEM_NSH=y
CONFIG_BOARDCTL_APP_INIT=y
```
